## Documentation/devicetree/bindings/clock/hi6250-clock.txt
```
* Hisilicon Hi6250 Clock Controller

Clock control registers reside in different Hi6250 system controllers,
please refer the following document to know more about the binding rules
for these system controllers:

Documentation/devicetree/bindings/arm/hisilicon/hisilicon.yaml

Required Properties:

- compatible: the compatible should be one of the following strings to
	indicate the clock controller functionality.

	- "hisilicon,hi6250-aoctrl"
	- "hisilicon,hi6250-sysctrl"
	- "hisilicon,hi6250-pmuctrl"
	- "hisilicon,hi6250-crgctrl"
	- "hisilicon,hi6250-stub-clk"

- reg: physical base address of the controller and length of memory mapped
  region.

- #clock-cells: should be 1.

Optional Properties:

- hisilicon,hi6250-sys-ctrl: phandle to the syscon managing the SoC internal sram;
  the driver need use the sram to pass parameters for frequency change.

- mboxes: use the label reference for the mailbox as the first parameter, the
  second parameter is the channel number.

Example 1:
	sys_ctrl: sys_ctrl@fff0a000 {
		compatible = "hisilicon,hi6250-sysctrl", "syscon";
		reg = <0x0 0xfff0a000 0x0 0x1000>;
		#clock-cells = <1>;
	};

Example 2:
	stub_clock: stub_clock {
		compatible = "hisilicon,hi6250-stub-clk";
		hisilicon,hi6250-sys-ctrl = <&sys_ctrl>;
		#clock-cells = <1>;
		mboxes = <&mailbox 13 3 0>;
	};

Each clock is assigned an identifier and client nodes use this identifier
to specify the clock which they consume.

All these identifier could be found in <dt-bindings/clock/hi6250-clock.h>.
```
