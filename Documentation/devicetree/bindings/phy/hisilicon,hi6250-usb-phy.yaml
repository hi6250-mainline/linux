## Documentation/devicetree/bindings/phy/hisilicon,hi6250-usb-phy.yaml
```yaml
# SPDX-License-Identifier: (GPL-2.0-only OR BSD-2-Clause)
%YAML 1.2
---
$id: http://devicetree.org/schemas/phy/hisilicon,hi6250-usb-phy.yaml#
$schema: http://devicetree.org/meta-schemas/core.yaml#

title: Hisilicon Hi6250 USB PHY

maintainers:
  - Tildeguy <tildeguy@mainlining.org>

properties:
  compatible:
    const: hisilicon,hi6250-usb-phy

  '#phy-cells':
    const: 0

  hisilicon,pericrg-syscon:
    description: Phandle to the peripheral CRG syscon.
    $ref: /schemas/types.yaml#/definitions/phandle

  hisilicon,pctrl-syscon:
    description: Phandle to the pin controller syscon.
    $ref: /schemas/types.yaml#/definitions/phandle

  hisilicon,ahbif-syscon:
    description: Phandle to the USB AHB interface syscon.
    $ref: /schemas/types.yaml#/definitions/phandle

  hisilicon,eye-pattern:
    description: USB PHY eye pattern tuning value.
    $ref: /schemas/types.yaml#/definitions/uint32

  hisilicon,host-eye-pattern:
    description: USB host PHY eye pattern tuning value.
    $ref: /schemas/types.yaml#/definitions/uint32

  mode-gpios:
    description: GPIO used to select the PHY mode.
    maxItems: 1

additionalProperties: false

examples:
  - |
    usbphy {
      compatible = "hisilicon,hi6250-usb-phy";
      hisilicon,pericrg-syscon = <&crg_ctrl>;
      hisilicon,pctrl-syscon = <&pctrl>;
      hisilicon,ahbif-syscon = <&usb_ahbif>;
      hisilicon,eye-pattern = <0x059066DB>;
      hisilicon,host-eye-pattern = <0x059066DB>;
      mode-gpios = <&gpio25 0 0>;
      #phy-cells = <0>;
    };
```

## Documentation/devicetree/bindings/power/reset/hisilicon,hi6250-reboot.yml
```yaml
# SPDX-License-Identifier: (GPL-2.0-only OR BSD-2-Clause)
%YAML 1.2
---
$id: http://devicetree.org/schemas/power/reset/hisilicon,hi6250-reboot.yaml#
$schema: http://devicetree.org/meta-schemas/core.yaml#

title: Hi6250 reboot and power-off driver

maintainers:
  - Tildeguy <tildeguy@mailining.org>

description: >
  The Hi6250 reboot and power-off driver provides system restart and
  power-off support using the Hi6250 PMU and system controller registers.
  The driver uses syscon phandles to access the PMU and system controller
  registers and a GPIO to control the power-hold signal during power-off.

allOf:
  - $ref: restart-handler.yaml#

properties:
  compatible:
    const: hisilicon,hi6250-reboot

  hisilicon,pmuctrl-syscon:
    $ref: /schemas/types.yaml#/definitions/phandle
    description: >
      Phandle to the Hi6250 PMU control syscon used by the reboot and
      power-off driver.

  hisilicon,sysctrl-syscon:
    $ref: /schemas/types.yaml#/definitions/phandle
    description: >
      Phandle to the Hi6250 system controller syscon used by the reboot
      and power-off driver.

  hisilicon,powerhold-gpios:
    description: >
      GPIO controlling the power-hold signal. The driver deasserts this
      signal when powering off the system.
    maxItems: 1

required:
  - compatible
  - hisilicon,pmuctrl-syscon
  - hisilicon,sysctrl-syscon
  - hisilicon,powerhold-gpios

additionalProperties: false

examples:
  - |
    hi6250-reboot {
      compatible = "hisilicon,hi6250-reboot";
      hisilicon,pmuctrl-syscon = <&pmu_ctrl>;
      hisilicon,sysctrl-syscon = <&sys_ctrl>;
      hisilicon,powerhold-gpios = <&gpio25 4 GPIO_ACTIVE_LOW>;
    };
```
